## conf/layer.conf
```bitbake
# We have a conf and classes directory, add to BBPATH
BBPATH .= ":${LAYERDIR}"

# We have recipes-* directories, add to BBFILES
BBFILES += "${LAYERDIR}/recipes-*/*/*.bb \
            ${LAYERDIR}/recipes-*/*/*.bbappend"

BBFILE_COLLECTIONS += "meta-torrey"
BBFILE_PATTERN_meta-torrey = "^${LAYERDIR}/"
BBFILE_PRIORITY_meta-torrey = "6"

LAYERDEPENDS_meta-torrey = "core"
LAYERSERIES_COMPAT_meta-torrey = "dunfell"
```
